## lab/part2_freeRTOS/lab1/lab1-1_1_core_sched/sdkconfig.defaults
```kconfig
# ESP32 with 4MB flash size
CONFIG_ESPTOOLPY_FLASHSIZE_4MB=y
CONFIG_ESPTOOLPY_FLASHSIZE="4MB"

# disable watchdog for task
CONFIG_ESP_TASK_WDT=n
CONFIG_ESP_TASK_WDT_CHECK_IDLE_TASK_CPU0=n
CONFIG_ESP_INT_WDT=n

# ONLY ONE CORE TO PERFORM FREERTOS
CONFIG_FREERTOS_UNICORE=y

#tRACE FACILITY TO EXTRACT TRACE INFORMATION 
CONFIG_FREERTOS_USE_TRACE_FACILITY=y
CONFIG_FREERTOS_USE_STATS_FORMATTING_FUNCTIONS=y
CONFIG_FREERTOS_VTASKLIST_INCLUDE_COREID=y

#allows add hook functions 
CONFIG_FREERTOS_LEGACY_HOOKS=n
CONFIG_FREERTOS_IDLE_TASK_STACKSIZE=4096
```
